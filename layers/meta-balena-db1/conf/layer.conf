## layers/meta-balena-db1/conf/layer.conf
```bitbake
BBPATH .= ":${LAYERDIR}"

BBFILES += "${LAYERDIR}/recipes-*/*/*.bb \
            ${LAYERDIR}/recipes-*/*/*.bbappend"

BBFILE_COLLECTIONS += "balena-db1"
BBFILE_PATTERN_balena-db1 := "^${LAYERDIR}/"
BBFILE_PRIORITY_balena-db1 = "1337"

LAYERSERIES_COMPAT_balena-db1 = "kirkstone"
```
